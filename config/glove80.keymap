// Edit this file directly. Layers are numbered in declaration order.
// https://zmk.dev/docs/config/keymap
// Keep each binding explicit so the TUI can edit one key without changing others.
#include "constants.h"

#include <behaviors.dtsi>
#include <dt-bindings/zmk/keys.h>
#include <dt-bindings/zmk/bt.h>
#include <dt-bindings/zmk/outputs.h>
#include <dt-bindings/zmk/rgb.h>
#include <dt-bindings/zmk/pointing.h>

&lt {
    LT_PROPERTIES
};

/ {
    #include "glove80-macros.dtsi"

    #include "glove80-behaviors.dtsi"

    combos {
        compatible = "zmk,combos";

        toggle_left_hand {
            key-positions = <52 69>;
            bindings = <&tog LAYER_CURSOR>;
        };

        mouse_toggle {
            key-positions = <74 57>;
            bindings = <&tog LAYER_MOUSE>;
        };

        caps_lock {
            key-positions = <39 40>;
            bindings = <&kp CAPS>;
            timeout-ms = <30>;
            require-prior-idle-ms = <300>;
        };

        caps_word {
            key-positions = <38 41>;
            bindings = <&caps_word>;
            timeout-ms = <30>;
            require-prior-idle-ms = <300>;
        };
    };

    conditional_layers {
        compatible = "zmk,conditional-layers";

        hebrew_symbols {
            if-layers = <LAYER_HEBREW LAYER_SYMBOLS>;
            then-layer = <LAYER_HEBREW_SYMBOLS>;
        };

        english_alpha_when_mod {
            if-layers = <LAYER_HEBREW LAYER_MOD_ACTIVE>;
            then-layer = <LAYER_ENGLISH_ALPHA>;
        };
    };

    keymap {
        compatible = "zmk,keymap";

        default {
            bindings = <
                &to LAYER_DEFAULT  &none  &none  &none  &none  &none  &none  &none  &none  &kp LC(LG(Q))
                &tog LAYER_HEBREW  &kp N1  &kp N2  &kp N3  &kp N4  &kp N5  &kp N6  &kp N7  &kp N8  &kp N9  &kp N0  &none
                &none  &kp Q  &kp W  &kp F  &kp P  &kp B  &kp J  &kp L  &kp U  &kp Y  &kp LC(LG(SPACE))  &none
                &none  &hml LCTRL A  &hml LALT R  &hml LGUI S  &hml LSHIFT T  &kp G  &kp M  &hmr RSHIFT N  &hmr RGUI E  &hmr RALT I  &hmr RCTRL O  &none
                &none  &kp Z  &kp X  &lt LAYER_TMUX C  &lt LAYER_MACROS D  &kp V  &lt LAYER_NUMBERS TAB  &lt LAYER_SYSTEM ESCAPE  &shift_caps LSHIFT 0  &shift_caps LSHIFT 0  &none  &lt LAYER_MOUSE ENTER  &kp K  &lt LAYER_MACROS H  &lt LAYER_TMUX COMMA  &kp DOT  &kp FSLH  &none
                &magic LAYER_MAGIC 0  &none  &none  &none  &none  &lt_mm_bspc_shift_del LAYER_CURSOR 0  &lt LAYER_MOUSE DEL  &mo LAYER_KEY_INDEX  &shot_ht LG(LS(N4)) LG(LS(N5))  &lt_td_launcher_prevapp LAYER_APPS 0  &lt LAYER_SYMBOLS SPACE  &dict_enter 0 ENTER  &none  &none  &none  &magic LAYER_MAGIC 0
            >;
        };

        magic {
            bindings = <
                &trans  &none  &none  &none  &none  &none  &none  &none  &bt BT_CLR  &bt BT_CLR_ALL
                &none  &none  &none  &none  &none  &none  &none  &none  &none  &none  &none  &none
                &none  &rgb_ug RGB_SPI  &rgb_ug RGB_SAI  &rgb_ug RGB_HUI  &rgb_ug RGB_BRI  &rgb_ug RGB_TOG  &none  &none  &none  &none  &none  &none
                &bootloader  &rgb_ug RGB_SPD  &rgb_ug RGB_SAD  &rgb_ug RGB_HUD  &rgb_ug RGB_BRD  &rgb_ug RGB_EFF  &none  &none  &none  &none  &none  &bootloader
                &sys_reset  &none  &none  &none  &none  &none  &bt_2  &bt_3  &none  &none  &none  &none  &none  &none  &none  &none  &none  &sys_reset
                &none  &none  &none  &none  &none  &bt_0  &bt_1  &out OUT_USB  &none  &none  &none  &none  &none  &none  &none  &to LAYER_FACTORY_TEST
            >;
        };

        factory_test {
            bindings = <
                &to LAYER_DEFAULT  &kp N6  &kp N2  &kp N8  &kp N4  &kp N4  &kp N8  &kp N2  &kp N6  &kp N0
                &kp N1  &kp N7  &kp N3  &kp N9  &kp N5  &kp N0  &kp N0  &kp N5  &kp N9  &kp N3  &kp N7  &kp N1
                &kp N2  &kp N8  &kp N4  &kp N0  &kp N6  &kp N1  &kp N1  &kp N6  &kp N0  &kp N4  &kp N8  &kp N2
                &kp N3  &kp N9  &kp N5  &kp N1  &kp N7  &kp N2  &kp N2  &kp N7  &kp N1  &kp N5  &kp N9  &kp N3
                &kp N4  &kp N0  &kp N6  &kp N2  &kp N8  &kp N3  &kp N4  &kp N5  &kp N6  &kp N6  &kp N5  &kp N4  &kp N3  &kp N8  &kp N2  &kp N6  &kp N0  &kp N4
                &kp N5  &kp N1  &kp N7  &kp N3  &kp N9  &kp N7  &kp N8  &kp N9  &kp N9  &kp N8  &kp N7  &kp N9  &kp N3  &kp N7  &kp N1  &kp N5
            >;
        };

        hebrew {
            bindings = <
                &trans  &trans  &trans  &trans  &trans  &trans  &trans  &trans  &trans  &trans
                &trans  &trans  &trans  &trans  &trans  &trans  &trans  &trans  &trans  &trans  &trans  &trans
                &trans  &kp PERIOD  &kp COMMA  &kp E  &kp R  &kp T  &kp Y  &kp U  &kp I  &kp O  &kp P  &trans
                &trans  &hml LCTRL A  &hml LALT S  &hml LGUI D  &hml LSHIFT F  &lt LAYER_APPS G  &lt LAYER_APPS H  &hmr RSHIFT J  &hmr RGUI K  &hmr RALT L  &hmr RCTRL SEMI  &kp APOS
                &trans  &kp Z  &kp X  &lt LAYER_TMUX C  &lt LAYER_MACROS V  &kp B  &trans  &trans  &trans  &trans  &trans  &trans  &kp N  &lt LAYER_MACROS M  &lt LAYER_TMUX APOS  &kp SLASH  &mm_q_shift_qmark  &trans
                &trans  &trans  &trans  &trans  &trans  &trans  &trans  &trans  &trans  &trans  &trans  &trans  &trans  &trans  &trans  &trans
            >;
        };

        numbers {
            bindings = <
                &trans  &trans  &trans  &trans  &trans  &trans  &trans  &trans  &trans  &trans
                &trans  &trans  &trans  &trans  &trans  &trans  &trans  &trans  &trans  &trans  &trans  &trans
                &trans  &trans  &trans  &trans  &trans  &trans  &trans  &kp N7  &kp N8  &kp N9  &kp F10  &trans
                &trans  &kp LCTRL  &kp LEFT_ALT  &kp LEFT_GUI  &kp LEFT_SHIFT  &trans  &trans  &kp N4  &kp N5  &kp N6  &kp F11  &trans
                &trans  &trans  &trans  &trans  &trans  &trans  &trans  &trans  &trans  &trans  &trans  &trans  &trans  &kp N1  &kp N2  &kp N3  &kp FSLH  &trans
                &trans  &trans  &trans  &trans  &trans  &trans  &trans  &trans  &trans  &trans  &kp N0  &trans  &trans  &kp DOT  &trans  &trans
            >;
        };

        symbols {
            bindings = <
                &trans  &trans  &trans  &trans  &trans  &trans  &trans  &trans  &trans  &trans
                &trans  &trans  &trans  &trans  &trans  &trans  &trans  &trans  &trans  &trans  &trans  &trans
                &trans  &trans  &trans  &kp COLON  &kp ESC  &trans  &kp CARET  &kp AMPS  &kp STAR  &kp PIPE  &trans  &trans
                &trans  &hml LCTRL BSLH  &kp EQUAL  &hml LGUI MINUS  &kp UNDER  &kp GRAVE  &kp SQT  &kp DOUBLE_QUOTES  &hmr RGUI PLUS  &kp TILDE  &hmr RCTRL FSLH  &trans
                &trans  &kp LESS_THAN  &kp LEFT_BRACE  &kp LBKT  &kp LEFT_PARENTHESIS  &kp SEMI  &trans  &trans  &trans  &trans  &trans  &trans  &kp COLON  &kp RIGHT_PARENTHESIS  &kp RBKT  &kp RIGHT_BRACE  &kp GREATER_THAN  &trans
                &trans  &trans  &trans  &trans  &trans  &kp BSPC  &trans  &trans  &trans  &trans  &trans  &trans  &trans  &trans  &trans  &trans
            >;
        };

        hebrew_symbols {
            bindings = <
                &trans  &trans  &trans  &trans  &trans  &trans  &trans  &trans  &trans  &trans
                &trans  &trans  &trans  &trans  &trans  &trans  &trans  &trans  &trans  &trans  &trans  &trans
                &trans  &trans  &trans  &trans  &trans  &trans  &trans  &trans  &trans  &trans  &trans  &trans
                &trans  &trans  &trans  &trans  &trans  &trans  &kp W  &trans  &trans  &trans  &trans  &trans
                &trans  &trans  &trans  &trans  &trans  &kp GRAVE  &trans  &trans  &trans  &trans  &trans  &trans  &trans  &trans  &trans  &trans  &trans  &trans
                &trans  &trans  &trans  &trans  &trans  &trans  &trans  &trans  &trans  &trans  &trans  &trans  &trans  &trans  &trans  &trans
            >;
        };

        system {
            bindings = <
                &trans  &trans  &trans  &trans  &trans  &trans  &trans  &trans  &trans  &trans
                &trans  &trans  &trans  &trans  &trans  &trans  &trans  &trans  &trans  &trans  &trans  &trans
                &trans  &trans  &kp C_VOLUME_DOWN  &kp C_MUTE  &kp C_VOLUME_UP  &kp C_BRIGHTNESS_INC  &trans  &kp F7  &kp F8  &kp F9  &kp F10  &trans
                &trans  &trans  &kp C_PREV  &kp C_PLAY_PAUSE  &kp C_NEXT  &kp C_BRIGHTNESS_DEC  &trans  &kp F4  &kp F5  &kp F6  &kp F11  &trans
                &trans  &trans  &trans  &trans  &trans  &trans  &trans  &trans  &trans  &trans  &trans  &kp LG(LS(N5))  &trans  &kp F1  &kp F2  &kp F3  &kp F12  &trans
                &trans  &trans  &trans  &trans  &trans  &trans  &trans  &trans  &trans  &trans  &kp LEFT_ALT  &trans  &trans  &trans  &trans  &trans
            >;
        };

        mouse {
            bindings = <
                &trans  &trans  &trans  &trans  &trans  &trans  &trans  &trans  &trans  &trans
                &trans  &trans  &trans  &trans  &trans  &trans  &trans  &trans  &trans  &trans  &trans  &trans
                &trans  &trans  &trans  &trans  &trans  &trans  &trans  &msc SCRL_DOWN  &mmv MOVE_UP  &msc SCRL_UP  &trans  &trans
                &trans  &trans  &trans  &kp LCTRL  &kp LEFT_SHIFT  &trans  &trans  &mmv MOVE_LEFT  &mmv MOVE_DOWN  &mmv MOVE_RIGHT  &trans  &trans
                &trans  &trans  &kp LG(X)  &kp LG(C)  &trans  &kp LG(V)  &trans  &trans  &trans  &trans  &trans  &trans  &trans  &msc SCRL_LEFT  &tog LAYER_MOUSE  &msc SCRL_RIGHT  &trans  &trans
                &trans  &trans  &trans  &trans  &trans  &mo LAYER_MOUSE_SLOW  &trans  &trans  &trans  &trans  &mkp LCLK  &mkp LCLK  &mkp MCLK  &mkp RCLK  &trans  &trans
            >;
        };

        original_default {
            bindings = <
                &to LAYER_DEFAULT  &kp F2  &kp F3  &kp F4  &kp F5  &kp F6  &kp F7  &kp F8  &kp F9  &kp F10
                &kp EQUAL  &kp N1  &kp N2  &kp N3  &kp N4  &kp N5  &kp N6  &kp N7  &kp N8  &kp N9  &kp N0  &kp MINUS
                &kp TAB  &kp Q  &kp W  &kp E  &kp R  &kp T  &kp Y  &kp U  &kp I  &kp O  &kp P  &kp BSLH
                &kp ESC  &kp A  &kp S  &kp D  &kp F  &kp G  &kp H  &kp J  &kp K  &kp L  &kp SEMI  &kp SQT
                &kp GRAVE  &kp Z  &kp X  &kp C  &kp V  &kp B  &kp LSHFT  &kp LCTRL  &kp LEFT_GUI  &kp RMETA  &kp RCTRL  &kp RSHFT  &kp N  &kp M  &kp COMMA  &kp DOT  &kp FSLH  &kp PG_UP
                &magic LAYER_MAGIC 0  &kp HOME  &kp END  &kp LEFT  &kp RIGHT  &kp BSPC  &kp DEL  &kp LALT  &kp RALT  &kp RET  &kp SPACE  &kp UP  &kp DOWN  &kp LBKT  &kp RBKT  &kp PG_DN
            >;
        };

        macros {
            bindings = <
                &trans  &trans  &trans  &trans  &trans  &trans  &trans  &trans  &trans  &trans
                &trans  &trans  &trans  &trans  &trans  &trans  &trans  &trans  &trans  &trans  &trans  &trans
                &trans  &vim_q  &vim_w  &vg_enter  &v_space_ctrl_t  &kp LC(LS(LG(B)))  &trans  &trans  &trans  &trans  &trans  &trans
                &trans  &trans  &trans  &trans  &trans  &trans  &trans  &trans  &trans  &trans  &trans  &trans
                &trans  &vim_cq  &vim_x  &copy_url  &lang_toggle  &trans  &trans  &trans  &trans  &trans  &trans  &trans  &trans  &lang_toggle  &trans  &trans  &trans  &trans
                &trans  &trans  &trans  &trans  &trans  &delete_to_bol  &delete_to_eol  &trans  &trans  &trans  &trans  &trans  &trans  &trans  &trans  &trans
            >;
        };

        mouse_slow {
            bindings = <
                &trans  &trans  &trans  &trans  &trans  &trans  &trans  &trans  &trans  &trans
                &trans  &trans  &trans  &trans  &trans  &trans  &trans  &trans  &trans  &trans  &trans  &trans
                &trans  &trans  &trans  &trans  &trans  &trans  &trans  &trans  &mmv MOVE_Y(-MOUSE_PRECISION_SPEED)  &trans  &trans  &trans
                &trans  &trans  &trans  &trans  &trans  &trans  &trans  &mmv MOVE_X(-MOUSE_PRECISION_SPEED)  &mmv MOVE_Y(MOUSE_PRECISION_SPEED)  &mmv MOVE_X(MOUSE_PRECISION_SPEED)  &trans  &trans
                &trans  &trans  &trans  &trans  &trans  &trans  &trans  &trans  &trans  &trans  &trans  &trans  &trans  &trans  &trans  &trans  &trans  &trans
                &trans  &trans  &trans  &trans  &trans  &trans  &trans  &trans  &trans  &trans  &trans  &trans  &trans  &trans  &trans  &trans
            >;
        };

        mod_active {
            bindings = <
                &trans  &trans  &trans  &trans  &kp X  &kp X  &trans  &trans  &trans  &trans
                &trans  &trans  &trans  &trans  &trans  &trans  &trans  &trans  &trans  &trans  &trans  &trans
                &trans  &trans  &trans  &trans  &trans  &trans  &trans  &trans  &trans  &trans  &trans  &trans
                &trans  &trans  &trans  &trans  &trans  &trans  &trans  &trans  &trans  &trans  &trans  &trans
                &trans  &trans  &trans  &trans  &trans  &trans  &trans  &trans  &trans  &trans  &trans  &trans  &trans  &trans  &trans  &trans  &trans  &trans
                &trans  &trans  &trans  &trans  &trans  &trans  &trans  &trans  &trans  &trans  &trans  &trans  &trans  &trans  &trans  &trans
            >;
        };

        english_alpha {
            bindings = <
                &trans  &trans  &trans  &trans  &trans  &trans  &trans  &trans  &trans  &trans
                &trans  &trans  &trans  &trans  &trans  &trans  &trans  &trans  &trans  &trans  &trans  &trans
                &trans  &kp Q  &kp W  &kp F  &kp P  &kp B  &kp J  &kp L  &kp U  &kp Y  &trans  &trans
                &trans  &hml LCTRL A  &hml LALT R  &hml LGUI S  &hml LSHIFT T  &hml LA(LGUI) G  &hmr RA(RGUI) M  &hmr RSHIFT N  &hmr RGUI E  &hmr RALT I  &hmr RCTRL O  &trans
                &trans  &kp Z  &kp X  &kp C  &kp D  &kp V  &trans  &trans  &trans  &trans  &trans  &trans  &kp K  &kp H  &trans  &trans  &trans  &trans
                &trans  &trans  &trans  &trans  &trans  &trans  &trans  &trans  &trans  &trans  &trans  &trans  &trans  &trans  &trans  &trans
            >;
        };

        cursor {
            bindings = <
                &trans  &trans  &trans  &trans  &trans  &trans  &trans  &trans  &trans  &trans
                &trans  &trans  &trans  &trans  &trans  &trans  &trans  &trans  &trans  &trans  &trans  &trans
                &trans  &trans  &trans  &trans  &trans  &trans  &trans  &kp PG_UP  &kp UP  &kp PG_DN  &trans  &trans
                &trans  &kp LCTRL  &kp LALT  &kp LGUI  &kp LSHIFT  &trans  &trans  &kp LEFT  &kp DOWN  &kp RIGHT  &trans  &trans
                &trans  &kp LG(Z)  &kp LG(X)  &kp LG(C)  &kp LG(D)  &kp LG(V)  &trans  &trans  &trans  &trans  &trans  &trans  &trans  &kp LG(LEFT)  &trans  &kp LG(RIGHT)  &trans  &trans
                &trans  &trans  &trans  &trans  &trans  &trans  &trans  &trans  &trans  &trans  &kp ENTER  &trans  &trans  &trans  &trans  &trans
            >;
        };

        // @label Apps
        apps {
            bindings = <
                &trans  &trans  &trans  &trans  &trans  &trans  &trans  &trans  &trans  &trans
                &trans  &kp LG(N1)  &kp LG(N2)  &kp LG(N3)  &kp LG(N4)  &kp LG(N5)  &kp LG(N6)  &kp LG(N7)  &kp LG(N8)  &kp LG(N9)  &kp LG(N0)  &trans
                &trans  &app_alt LC(LS(LG(LA(Q)))) LC(LS(LG(Q)))  &app_alt LC(LS(LG(LA(W)))) LC(LS(LG(W)))  &app_alt LC(LS(LG(LA(F)))) LC(LS(LG(F)))  &app_alt LC(LS(LG(LA(P)))) LC(LS(LG(P)))  &kp LC(LS(LG(B)))  &app_alt LC(LS(LG(LA(J)))) LC(LS(LG(J)))  &app_alt LC(LS(LG(LA(L)))) LC(LS(LG(L)))  &app_alt LC(LS(LG(LA(U)))) LC(LS(LG(U)))  &app_alt LC(LS(LG(LA(Y)))) LC(LS(LG(Y)))  &trans  &trans
                &trans  &app_alt LC(LS(LG(LA(A)))) LC(LS(LG(A)))  &app_alt LC(LS(LG(LA(R)))) LC(LS(LG(R)))  &app_alt LC(LS(LG(LA(S)))) LC(LS(LG(S)))  &app_alt LC(LS(LG(LA(T)))) LC(LS(LG(T)))  &app_alt LC(LS(LG(LA(G)))) LC(LS(LG(G)))  &app_alt LC(LS(LG(LA(M)))) LC(LS(LG(M)))  &app_alt LC(LS(LG(LA(N)))) LC(LS(LG(N)))  &app_alt LC(LS(LG(LA(E)))) LC(LS(LG(E)))  &app_alt LC(LS(LG(LA(I)))) LC(LS(LG(I)))  &app_alt LC(LS(LG(LA(O)))) LC(LS(LG(O)))  &trans
                &trans  &app_alt LC(LS(LG(LA(Z)))) LC(LS(LG(Z)))  &app_alt LC(LS(LG(LA(X)))) LC(LS(LG(X)))  &app_alt LC(LS(LG(LA(C)))) LC(LS(LG(C)))  &app_alt LC(LS(LG(LA(D)))) LC(LS(LG(D)))  &app_alt LC(LS(LG(LA(V)))) LC(LS(LG(V)))  &trans  &trans  &trans  &trans  &trans  &trans  &app_alt LC(LS(LG(LA(K)))) LC(LS(LG(K)))  &app_alt LC(LS(LG(LA(H)))) LC(LS(LG(H)))  &trans  &trans  &trans  &trans
                &trans  &trans  &trans  &trans  &trans  &dictation  &trans  &trans  &trans  &trans  &trans  &trans  &trans  &trans  &trans  &trans
            >;
        };

        key_index {
            bindings = <
                &kp N0  &kp N1  &kp N2  &kp N3  &kp N4  &kp N5  &kp N6  &kp N7  &kp N8  &kp N9
                &type_2digits N1 N0  &type_2digits N1 N1  &type_2digits N1 N2  &type_2digits N1 N3  &type_2digits N1 N4  &type_2digits N1 N5  &type_2digits N1 N6  &type_2digits N1 N7  &type_2digits N1 N8  &type_2digits N1 N9  &type_2digits N2 N0  &type_2digits N2 N1
                &type_2digits N2 N2  &type_2digits N2 N3  &type_2digits N2 N4  &type_2digits N2 N5  &type_2digits N2 N6  &type_2digits N2 N7  &type_2digits N2 N8  &type_2digits N2 N9  &type_2digits N3 N0  &type_2digits N3 N1  &type_2digits N3 N2  &type_2digits N3 N3
                &type_2digits N3 N4  &type_2digits N3 N5  &type_2digits N3 N6  &type_2digits N3 N7  &type_2digits N3 N8  &type_2digits N3 N9  &type_2digits N4 N0  &type_2digits N4 N1  &type_2digits N4 N2  &type_2digits N4 N3  &type_2digits N4 N4  &type_2digits N4 N5
                &type_2digits N4 N6  &type_2digits N4 N7  &type_2digits N4 N8  &type_2digits N4 N9  &type_2digits N5 N0  &type_2digits N5 N1  &type_2digits N5 N2  &type_2digits N5 N3  &type_2digits N5 N4  &type_2digits N5 N5  &type_2digits N5 N6  &type_2digits N5 N7  &type_2digits N5 N8  &type_2digits N5 N9  &type_2digits N6 N0  &type_2digits N6 N1  &type_2digits N6 N2  &type_2digits N6 N3
                &type_2digits N6 N4  &type_2digits N6 N5  &type_2digits N6 N6  &type_2digits N6 N7  &type_2digits N6 N8  &type_2digits N6 N9  &type_2digits N7 N0  &type_2digits N7 N1  &type_2digits N7 N2  &type_2digits N7 N3  &type_2digits N7 N4  &type_2digits N7 N5  &type_2digits N7 N6  &type_2digits N7 N7  &type_2digits N7 N8  &type_2digits N7 N9
            >;
        };

        tmux {
            bindings = <
                &trans  &trans  &trans  &trans  &trans  &trans  &trans  &trans  &trans  &trans
                &trans  &ctrl_a N1  &ctrl_a N2  &ctrl_a N3  &ctrl_a N4  &ctrl_a N5  &ctrl_a N6  &ctrl_a N7  &ctrl_a N8  &ctrl_a N9  &ctrl_a N0  &trans
                &trans  &ctrl_a Q  &ctrl_a W  &ctrl_a F  &ctrl_a P  &ctrl_a B  &ctrl_a J  &ctrl_a L  &ctrl_a U  &ctrl_a Y  &ctrl_a SEMI  &trans
                &trans  &ctrl_a A  &ctrl_a R  &ctrl_a S  &ctrl_a T  &ctrl_a G  &ctrl_a M  &ctrl_a N  &ctrl_a E  &ctrl_a I  &ctrl_a O  &trans
                &trans  &hml_ctrl_a LCTRL Z  &hml_ctrl_a LALT X  &ctrl_a C  &hml_ctrl_a LSHIFT D  &ctrl_a V  &ctrl_a TAB  &ctrl_a ESCAPE  &kp LSHIFT  &kp LSHIFT  &trans  &ctrl_a TAB  &ctrl_a K  &hmr_ctrl_a RSHIFT H  &ctrl_a COMMA  &hmr_ctrl_a RALT DOT  &hmr_ctrl_a RCTRL FSLH  &trans
                &trans  &ctrl_a GRAVE  &ctrl_a ESC  &ctrl_a SPACE  &ctrl_a ENTER  &ctrl_a BSPC  &ctrl_a DEL  &trans  &trans  &trans  &ctrl_a SPACE  &ctrl_a ENTER  &trans  &ctrl_a ESC  &ctrl_a TILDE  &trans
            >;
        };
    };
};
